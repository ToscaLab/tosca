## ascot-esp32c3/devices/light/sdkconfig.defaults
```kconfig
# Stack size used by the board. If there are some stack blowups, increase this
# value until there are no more issues. This value is based on a Rust build with
# a release profile.
CONFIG_ESP_MAIN_TASK_STACK_SIZE=30000
# Stack size associated to system event
CONFIG_ESP_SYSTEM_EVENT_TASK_STACK_SIZE=8192
# Default stack size associated to each thread
CONFIG_PTHREAD_TASK_STACK_SIZE_DEFAULT=8192
```

## ascot-esp32c3/sdkconfig.defaults
```kconfig
# Stack size used by the board. If there are some stack blowups, increase this
# value until there are no more issues. This value is based on a Rust build with
# a release profile and an unwrap strategy for errors. It is necessary to fiddle
# with the debug profile not to have stack blowups for a debug build.
CONFIG_ESP_MAIN_TASK_STACK_SIZE=130000
# The stack size for a default debug build profile should be higher since it
# has less optizations.
#CONFIG_ESP_MAIN_TASK_STACK_SIZE=150000
# Stack size associated to system event
CONFIG_ESP_SYSTEM_EVENT_TASK_STACK_SIZE=8192
# Default stack size associated to each thread
CONFIG_PTHREAD_TASK_STACK_SIZE_DEFAULT=8192
```

## crates/ascot-esp32c3/sdkconfig.defaults
```kconfig
# Stack size used by the board. If there are some stack blowups, increase this
# value until there are no more issues.
CONFIG_ESP_MAIN_TASK_STACK_SIZE=40000
# Stack size for system events.
CONFIG_ESP_SYSTEM_EVENT_TASK_STACK_SIZE=8192
# Default stack size for each thread run on the board.
CONFIG_PTHREAD_TASK_STACK_SIZE_DEFAULT=8192
```
